## conf/machine/dragonboard-410c.conf
```bitbake
#@TYPE: Machine
#@NAME: dragonboard-410c
#@DESCRIPTION: Machine configuration for the DragonBoard 410c (96boards), with Qualcomm Snapdragon 410 APQ8016.

require conf/machine/include/qcom-apq8016.inc

MACHINE_FEATURES = "usbhost usbgadget alsa screen wifi bluetooth ext2"

KERNEL_DEFCONFIG ?= "${S}/arch/arm64/configs/defconfig"
KERNEL_IMAGETYPE = "Image"
KERNEL_DEVICETREE = "qcom/apq8016-sbc.dtb"

SERIAL_CONSOLE = "115200 ttyMSM0"

MACHINE_ESSENTIAL_EXTRA_RRECOMMENDS += " \
    kernel-modules \
    ${@bb.utils.contains('DISTRO_FEATURES', 'opengl', 'mesa-driver-msm', '', d)} \
    ${@bb.utils.contains('DISTRO_FEATURES', 'wifi', 'wcnss-config wcnss-start', '', d)} \
    ${@bb.utils.contains('DISTRO_FEATURES', 'bluez5', 'bluez5-noinst-tools', '', d)} \
    ${@'firmware-qcom-dragonboard410c' if d.getVar('ACCEPT_EULA_dragonboard-410c', True) == '1' else ''} \
"

BOOTIMG_CMDLINE_ROOT ?= "root=/dev/mmcblk0p10 rootwait"
BOOTIMG_PAGE_SIZE ?= "2048"
BOOTIMG_BASE_ADDR ?= "0x80000000"
DT_IMAGE_BASE_NAME ?= "dt-${KERNEL_IMAGE_BASE_NAME}"
DT_IMAGE_SYMLINK_NAME ?= "dt-${KERNEL_IMAGE_SYMLINK_NAME}"

IMAGE_CLASSES += "image_types_fastboot"
# Fastboot expects an ext4 image, which needs to be 4096 aligned
IMAGE_ROOTFS_ALIGNMENT = "4096"
```

## conf/machine/ifc6410.conf
```bitbake
#@TYPE: Machine
#@NAME: ifc6410
#@DESCRIPTION: Machine configuration for the Inforce IFC6410, with Qualcomm Snapdragon 600 APQ8064.

require conf/machine/include/qcom-apq8064.inc

# features
MACHINE_FEATURES = "alsa kernel26 screen usb keyboard wifi ext2 ext3"

MACHINE_EXTRA_RRECOMMENDS = " \
    kernel-modules \
    ${@bb.utils.contains('DISTRO_FEATURES', 'opengl', 'mesa-driver-msm', '', d)} \
"

KERNEL_DEFCONFIG ?= "${S}/arch/arm/configs/qcom_defconfig"
KERNEL_IMAGETYPE = "zImage"
KERNEL_DEVICETREE = "qcom-apq8064-ifc6410.dtb"

SERIAL_CONSOLE = "115200 ttyMSM0"

BOOTIMG_CMDLINE_ROOT ?= "root=/dev/mmcblk0p12 rootwait"
BOOTIMG_PAGE_SIZE ?= "2048"
BOOTIMG_BASE_ADDR ?= "0x80200000"
DT_IMAGE_BASE_NAME ?= ""
DT_IMAGE_SYMLINK_NAME ?= ""

IMAGE_CLASSES += "image_types_fastboot"
# Fastboot expects an ext4 image, which needs to be 4096 aligned
IMAGE_ROOTFS_ALIGNMENT = "4096"

INHERIT += "qcom-firmware-mount"
```

## conf/machine/include/qcom-apq8016.inc
```bitbake
SOC_FAMILY = "apq8016"
require conf/machine/include/soc-family.inc
require conf/machine/include/arm/arch-armv8.inc

XSERVER_OPENGL ?= " \
    xf86-video-freedreno \
    xserver-xorg-module-exa \
    xserver-xorg-extension-glx \
    xserver-xorg-extension-dri \
"

XSERVER ?= " \
    xserver-xorg \
    xserver-xorg-module-libint10 \
    ${@bb.utils.contains('DISTRO_FEATURES', 'opengl', '${XSERVER_OPENGL}', 'xf86-video-fbdev', d)} \
    xf86-input-evdev \
    xf86-input-mouse \
    xf86-input-keyboard \
"

PREFERRED_PROVIDER_virtual/egl ?= "mesa"
PREFERRED_PROVIDER_virtual/libgl ?= "mesa"
PREFERRED_PROVIDER_virtual/libgles1 ?= "mesa"
PREFERRED_PROVIDER_virtual/libgles2 ?= "mesa"
PREFERRED_PROVIDER_virtual/xserver ?= "xserver-xorg"
PREFERRED_PROVIDER_virtual/kernel ?= "linux-linaro-qcomlt"

BOOTIMG_CMDLINE_ROOT ?= "root=/dev/mmcblk0p10 rootwait"
BOOTIMG_PAGE_SIZE ?= "2048"
BOOTIMG_BASE_ADDR ?= "0x80000000"
DT_IMAGE_BASE_NAME ?= "dt-${KERNEL_IMAGE_BASE_NAME}"
DT_IMAGE_SYMLINK_NAME ?= "dt-${KERNEL_IMAGE_SYMLINK_NAME}"

IMAGE_ROOTFS_ALIGNMENT = "4096"
```

## conf/machine/include/qcom-apq8064.inc
```bitbake
SOC_FAMILY = "apq8064"
require conf/machine/include/soc-family.inc
require conf/machine/include/tune-cortexa8.inc

XSERVER_OPENGL ?= "xf86-video-freedreno \
                   xserver-xorg-module-exa \
                   xserver-xorg-extension-glx \
                   xserver-xorg-extension-dri \
                  "

XSERVER = " \
	xserver-xorg \
    ${@bb.utils.contains('DISTRO_FEATURES', 'opengl', '${XSERVER_OPENGL}', 'xf86-video-fbdev', d)} \
	xf86-input-mouse \
	xf86-input-keyboard \
	xf86-input-evdev \
"

PREFERRED_PROVIDER_virtual/egl ?= "mesa"
PREFERRED_PROVIDER_virtual/libgl ?= "mesa"
PREFERRED_PROVIDER_virtual/libgles1 ?= "mesa"
PREFERRED_PROVIDER_virtual/libgles2 ?= "mesa"
PREFERRED_PROVIDER_virtual/xserver = "xserver-xorg"
PREFERRED_PROVIDER_virtual/kernel = "linux-linaro-qcomlt"

BOOTIMG_CMDLINE_ROOT ?= "root=/dev/mmcblk0p12 rootwait"
BOOTIMG_PAGE_SIZE ?= "2048"
BOOTIMG_BASE_ADDR ?= "0x80200000"
DT_IMAGE_BASE_NAME ?= ""
DT_IMAGE_SYMLINK_NAME ?= ""

IMAGE_ROOTFS_ALIGNMENT = "4096"
```
